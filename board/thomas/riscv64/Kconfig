## board/thomas/riscv64/Kconfig
```kconfig
if TARGET_THOMAS_RISCV64
config SYS_BOARD
	default "riscv64"

config SYS_VENDOR
	default "thomas"

config SYS_CONFIG_NAME
	default "thomas_riscv64"

config SYS_CPU
	default "riscv64"

config BOARD_SPECIFIC_OPTIONS
	def_bool y
	select THOMAS_RISCV64
	select SUPPORT_SPL

endif
```

## board/thomas/riscv64/thomas_riscv64.its
```
/*
 * Compilation:
 * mkimage -f fit_kernel_dtb.its fit_kernel_dtb.itb
 *
 */

/dts-v1/;
/ {
	description = "U-Boot FIT for thomas riscv64";
	#address-cells = <2>;

	images {
		kernel {
			description = "Linux kernel";
			data = /incbin/("Image");
			type = "kernel";
			arch = "riscv";
			os = "linux";
			compression = "none";
			load = <0x0 0x51000000>;
			entry = <0x0 0x51000000>;
			/*
			hash-1 {
				algo = "sha1";
			};
			*/
		};

		ramdisk {
			description = "Linux ramdisk";
			data = /incbin/("rootfs.cpio.gz");
			type = "ramdisk";
			arch = "riscv";
			os = "linux";
			compression = "none";
			/*
			hash-1 {
				algo = "crc32";
			};
			*/
		};

		fdt-thomas-riscv64 {
			description = "FDT thomas riscv64";
			data = /incbin/("thomas_riscv64.dtb");
			type = "flat_dt";
			arch = "riscv";
			compression = "none";
			hash-1 {
				algo = "sha1";
			};
		};
	};

	configurations {
		default = "thomas_riscv64";

		thomas_riscv64 {
			description = "thomas_riscv64";
			kernel = "kernel";
			ramdisk = "ramdisk";
			fdt = "fdt-thomas-riscv64";
		};
	};
};
```

## board/thomas/riscv64/thomas_riscv64_spl.its
```
/dts-v1/;

/ {
        description = "UBoot SPL Image";
        #address-cells = <2>;

        images {
                opensbi {
                        description = "OpenSBI Dynamic Firmaware";
                        data = /incbin/("../../../thomas_riscv64/images/fw_jump.bin");
                        type = "firmware";
                        arch = "riscv";
                        os = "opensbi";
                        load =  <0x0 0x20040000>;
                        entry = <0x0 0x20040000>;
                        compression = "none";
                        hash-1 {
                                algo = "sha256";
                        };
                };

                uboot {
                        description = "U-Boot";
                        data = /incbin/("u-boot.bin");
                        type = "standalone";
                        arch = "riscv";
                        os = "U-Boot";
                        load = <0x0 0x50000000>;
                        entry = <0x0 0x50000000>;
                        compression = "none";
                        hash-1 {
                                algo = "sha256";
                        };
                };

                fdt {
                        description = "Firmware DTB";
                        data = /incbin/("dts/dt.dtb");
                        type = "flat_dt";
                        arch = "riscv";
                        load = <0x0 0x200c0000>;
                        entry = <0x0 0x200c0000>;
                        compression = "none";
                        hash-1 {
                                algo = "sha256";
                        };
                };

        };

        configurations {
                default = "boot";

                boot {
                        description = "UBoot SPL";
                        firmware = "opensbi";
                        loadables = "uboot";
                        fdt = "fdt";
                };

        };
};
```

## board/virtual_platform/a15/Kconfig
```kconfig
if TARGET_A15

config SYS_BOARD
	default "a15"

config SYS_VENDOR
	default "virtual_platform"

config SYS_CONFIG_NAME
	default "a15"

endif
```

## board/virtual_platform/a55/Kconfig
```kconfig
if TARGET_A55

config SYS_BOARD
	default "a55"

config SYS_VENDOR
	default "virtual_platform"

config SYS_CONFIG_NAME
	default "a55"

endif
```

## configs/a15_defconfig
```kconfig
CONFIG_ARM=y
CONFIG_TARGET_A15=y

CONFIG_SYS_ARCH="arm"
CONFIG_SYS_CPU="armv7"
CONFIG_SYS_VENDOR="virtual_platform"
CONFIG_SYS_BOARD="a15"
CONFIG_SYS_CONFIG_NAME="a15"

# DDR 0x20000000 .. 0x27ffffff 128M
# u-boot base address
CONFIG_SYS_TEXT_BASE=0x20000000

# kernel load address
# offset 16M from u-boot base address
CONFIG_SYS_LOAD_ADDR=0x21000000

# timer
CONFIG_SYS_ARCH_TIMER=y

# uart
CONFIG_BAUDRATE=115200
CONFIG_REQUIRE_SERIAL_CONSOLE=y
CONFIG_PL011_SERIAL=y
CONFIG_CONS_INDEX=0

# add fdt support
CONFIG_OF_LIBFDT=y
```

## configs/a55_defconfig
```kconfig
CONFIG_ARM=y
CONFIG_TARGET_A55=y

#CONFIG_SYS_VENDOR="virtual_platform"
#CONFIG_SYS_BOARD="a55"
#CONFIG_SYS_CONFIG_NAME="a55"

CONFIG_HAS_CUSTOM_SYS_INIT_SP_ADDR=y
CONFIG_CUSTOM_SYS_INIT_SP_ADDR=0x32000000

# u-boot base address
CONFIG_SYS_TEXT_BASE=0x31000000

# kernel load address
# offset 16M from u-boot base address
CONFIG_SYS_LOAD_ADDR=0x33000000

# timer
CONFIG_SYS_ARCH_TIMER=y

# uart
#CONFIG_BAUDRATE=115200
#CONFIG_REQUIRE_SERIAL_CONSOLE=y
CONFIG_SYS_NS16550=y
CONFIG_CONS_INDEX=1
CONFIG_DM_SERIAL=y

# add fdt support
CONFIG_OF_CONTROL=y
CONFIG_OF_LIBFDT=y
CONFIG_DEFAULT_DEVICE_TREE="a55"
CONFIG_OF_SEPARATE=y

# cmdline hush parser
CONFIG_HUSH_PARSER=y
```

## configs/thomas_riscv64_defconfig
```kconfig
CONFIG_RISCV=y
CONFIG_TEXT_BASE=0x50000000
CONFIG_SYS_MALLOC_LEN=0x800000
CONFIG_NR_DRAM_BANKS=1
CONFIG_ENV_SIZE=0x20000
CONFIG_DEFAULT_DEVICE_TREE="thomas-riscv64"
CONFIG_SPL_TEXT_BASE=0x20000000
CONFIG_SYS_MONITOR_LEN=524288
CONFIG_SPL_MMC=y
CONFIG_SPL=y
CONFIG_SYS_LOAD_ADDR=0x51000000
CONFIG_TARGET_THOMAS_RISCV64=y
CONFIG_SPL_OPENSBI_LOAD_ADDR=0x20040000
CONFIG_ARCH_RV64I=y
CONFIG_CMODEL_MEDANY=y
CONFIG_RISCV_SMODE=y
# CONFIG_RISCV_ISA_F is not set
CONFIG_SHOW_REGS=y
CONFIG_FIT=y
CONFIG_SPL_FIT_PRINT=y
CONFIG_SPL_LOAD_FIT_ADDRESS=0x41000000
CONFIG_SPL_FIT_SOURCE="board/thomas/riscv64/thomas_riscv64_spl.its"
CONFIG_DISPLAY_CPUINFO=y
CONFIG_DISPLAY_BOARDINFO=y
CONFIG_BOARD_EARLY_INIT_F=y
CONFIG_SPL_MAX_SIZE=0x40000
CONFIG_SPL_BSS_START_ADDR=0x20030000
CONFIG_SPL_BSS_MAX_SIZE=0x10000
CONFIG_SYS_MMCSD_RAW_MODE_U_BOOT_USE_SECTOR=y
CONFIG_SYS_MMCSD_RAW_MODE_U_BOOT_SECTOR=100
CONFIG_SPL_RAM_SUPPORT=y
CONFIG_SPL_RAM_DEVICE=y
CONFIG_HUSH_PARSER=y
CONFIG_SYS_PROMPT="THOMAS RISCV64 U-Boot> "
CONFIG_SYS_BOOTM_LEN=0x4000000
CONFIG_CMD_LSBLK=y
CONFIG_CMD_MMC=y
CONFIG_CMD_MTD=y
CONFIG_CMD_FAT=y
CONFIG_CMD_MTDPARTS=y
CONFIG_CMD_LOG=y
CONFIG_OF_EMBED=y
CONFIG_OF_SPL_REMOVE_PROPS=""
CONFIG_SYS_RELOC_GD_ENV_ADDR=y
# CONFIG_NET is not set
CONFIG_SPL_CLK=y
CONFIG_MISC=y
CONFIG_MMC=y
CONFIG_MMC_SDHCI=y
CONFIG_MMC_SDHCI_THOMAS_RISCV64=y
CONFIG_DM_MTD=y
CONFIG_SYS_NS16550=y
CONFIG_SYS_NS16550_MEM32=y
CONFIG_HEXDUMP=y
# CONFIG_EFI_LOADER is not set
```

## drivers/io/Kconfig
```kconfig
config SPL_FIP_IO
	bool "Enable fip io driver support"
	depends on SPL_FIP

config SPL_FIP_IO_DUMMY
	bool "Enable fip io dummy driver support"
	depends on SPL_FIP_IO

config SPL_FIP_IO_MEMORY
	bool "Enable fip io memory driver support"
	depends on SPL_FIP_IO

config SPL_FIP_IO_BLOCK
	bool "Enable fip io block driver support"
	depends on SPL_FIP_IO
```
